/*
 * Enable the V3D node on BCM2712 (nextbsd-kernel-extensions-graphics#51).
 *
 * bcm2712-ds.dtsi ships v3d@2000000 with status = "disabled", so the node is
 * present but never probed:
 *
 *	simplebus1: <v3d@2000000> mem 0x1002000000-...,0x1002030800-0x1002030eff
 *	    irq 70,71 disabled compat brcm,2712-v3d (no driver attached)
 *
 * This flips that one property and nothing else.
 *
 * IT DOES NOT BY ITSELF GIVE YOU 3D. Nothing in tree binds "brcm,2712-v3d",
 * so /dev/dri stays card0 with no renderD128. GL needs all of:
 *
 *   1. this overlay
 *   2. a v3d DRM driver exposing a render node
 *   3. drm_gpu_scheduler, which v3d depends on and nothing here provides
 *   4. mesa-libs built with vc4 and v3d in GALLIUM_DRIVERS (nextbsd#427)
 *
 * What it does prove, measured on a Pi 500+: the node comes up with the
 * "disabled" gone and both memory ranges and IRQs 70/71 resolved, and enabling
 * it disturbs neither the firmware framebuffer nor firmware KMS -- fb0 still
 * comes up and vc4_fkms0 still attaches with /dev/dri/card0.
 *
 * Safe to ship enabled: an unclaimed node costs a dmesg line.
 */
/dts-v1/;
/plugin/;

/ {
	compatible = "brcm,bcm2712";

	fragment@0 {
		target = <&v3d>;
		__overlay__ {
			status = "okay";
		};
	};
};
